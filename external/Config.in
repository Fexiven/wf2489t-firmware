## external/Config.in
```kconfig
menu "WF2489T packages"
	source "$BR2_EXTERNAL_WF2489T_PATH/package/wf2489t-rkbin/Config.in"
	source "$BR2_EXTERNAL_WF2489T_PATH/package/wf2489t-aic8800/Config.in"
endmenu
```

## external/board/wf2489t/u-boot.its
```
/*
 * Copyright (C) 2020 Rockchip Electronic Co.,Ltd
 *
 * Simple U-boot fit source file containing ATF/OP-TEE/U-Boot/dtb/MCU
 */

/dts-v1/;

/ {
	description = "FIT Image with ATF/OP-TEE/U-Boot/MCU";
	#address-cells = <1>;

	images {

		uboot {
			description = "U-Boot";
			data = /incbin/("u-boot-nodtb.bin");
			type = "standalone";
			arch = "arm64";
			os = "U-Boot";
			compression = "none";
			load = /bits/ 64 <0x40200000>;
			hash {
				algo = "sha256";
			};
		};
		atf-1 {
			description = "ARM Trusted Firmware";
			data = /incbin/("./bl31_0x40060000.bin");
			type = "firmware";
			arch = "arm64";
			os = "arm-trusted-firmware";
			compression = "none";
			load = /bits/ 64 <0x40060000>;
			hash {
				algo = "sha256";
			};
		};
		atf-2 {
			description = "ARM Trusted Firmware";
			data = /incbin/("./bl31_0x400f0000.bin");
			type = "firmware";
			arch = "arm64";
			os = "arm-trusted-firmware";
			compression = "none";
			load = /bits/ 64 <0x400f0000>;
			hash {
				algo = "sha256";
			};
		};
		atf-3 {
			description = "ARM Trusted Firmware";
			data = /incbin/("./bl31_0x3fe70000.bin");
			type = "firmware";
			arch = "arm64";
			os = "arm-trusted-firmware";
			compression = "none";
			load = /bits/ 64 <0x3fe70000>;
			hash {
				algo = "sha256";
			};
		};
		optee {
			description = "OP-TEE";
			data = /incbin/("tee.bin");
			type = "firmware";
			arch = "arm64";
			os = "op-tee";
			compression = "none";
			
			load = /bits/ 64 <0x48400000>;
			hash {
				algo = "sha256";
			};
		};
		fdt {
			description = "U-Boot dtb";
			data = /incbin/("./u-boot.dtb");
			type = "flat_dt";
			arch = "arm64";
			compression = "none";
			hash {
				algo = "sha256";
			};
		};
	};

	configurations {
		default = "conf";
		conf {
			description = "rk3576-evb";
			rollback-index = <0x0>;
			firmware = "atf-1";
			loadables = "uboot", "atf-2", "atf-3", "optee";
			
			fdt = "fdt";
			signature {
								algo = "sha256,rsa2048";
				
				key-name-hint = "dev";
				sign-images = "firmware", "loadables", "fdt";
			};
		};
	};
};
```

## external/package/wf2489t-aic8800/Config.in
```kconfig
config BR2_PACKAGE_WF2489T_AIC8800
	bool "wf2489t-aic8800"
	depends on BR2_LINUX_KERNEL
	help
	  Driver and firmware for the AIC8800D80 Wi-Fi chip (SDIO),
	  from Radxa's maintained package, with its Debian patches.

	  https://github.com/radxa-pkg/aic8800

comment "wf2489t-aic8800 needs a Linux kernel to be built"
	depends on !BR2_LINUX_KERNEL
```

## external/package/wf2489t-rkbin/Config.in
```kconfig
config BR2_PACKAGE_WF2489T_RKBIN
	bool "wf2489t-rkbin"
	depends on BR2_aarch64
	help
	  Rockchip RK3576 BL31 (TF-A) v1.25 and BL32 (OP-TEE) v1.12 from
	  rockchip-linux/rkbin, pinned to one commit. Both must come from the
	  same rkbin release; they end up in the U-Boot FIT.
```
