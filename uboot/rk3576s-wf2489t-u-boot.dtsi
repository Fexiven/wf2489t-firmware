// SPDX-License-Identifier: (GPL-2.0+ OR MIT)
/* U-Boot additions for the WF2489T wall tablet */

#include "rk3576-u-boot.dtsi"

&sdhci {
	/*
	 * 52 MHz: mainline U-Boot's RK3576 HS200/HS400 is unreliable with this
	 * eMMC (see docs/emmc.md). Linux runs HS200; boot costs ~1-2 s more.
	 */
	/delete-property/ mmc-hs200-1_8v;
	cap-mmc-highspeed;
	max-frequency = <52000000>;
};
